# core_cm4 register map
Registers are read-write, no defined reset value unless marked. A register's access mark holds for its fields unless they carry their own. Offsets are from the block's base; lines under a group give offsets from that group; [hi:lo] are bit positions; {n}, {i} and the like mark numbered series; 'fields as' and 'values as' point back to an identical list; <NAME> marks a mode.

## Memory map
0xE0000000 ITM size 0x1000 — Instrumentation Trace Macrocell
0xE0001000 DWT size 0x1000 — Data Watchpoint and Trace
0xE000E000 SCnSCB size 0x1000 — System Control and ID
0xE000E010 SysTick size 0x1000 — System Timer
0xE000E100 NVIC size 0x1000 — Nested Vectored Interrupt Controller
0xE000ED00 SCB size 0x1000 — System Control Block
0xE000ED90 MPU size 0x1000 — Memory Protection Unit
0xE000EDF0 CoreDebug size 0x1000
0xE000EF30 FPU size 0x1000 — Floating Point Unit
0xE0040000 TPI size 0x1000 — Trace Port Interface

## SCnSCB — System Control and ID
Base 0xE000E000
0x04 ICTR ro — Interrupt Controller Type Register
  [4:0] INTLINESNUM
0x08 ACTLR — Auxiliary Control Register
  [10:9] DISOOFP, [9:8] DISFPCA, [3:2] DISFOLD, [2:1] DISDEFWBUF, [1:0] DISMCYCINT

## SCB — System Control Block
Base 0xE000ED00
0x00 CPUID ro — CPUID Base Register
  [32:24] IMPLEMENTER, [24:20] VARIANT, [20:16] ARCHITECTURE, [16:4] PARTNO, [4:0] REVISION
0x04 ICSR — Interrupt Control and State Register
  [32:31] NMIPENDSET, [29:28] PENDSVSET, [28:27] PENDSVCLR, [27:26] PENDSTSET, [26:25] PENDSTCLR, [24:23] ISRPREEMPT, [23:22] ISRPENDING, [21:12] VECTPENDING, [12:11] RETTOBASE, [9:0] VECTACTIVE
0x08 VTOR — Vector Table Offset Register
  [32:7] TBLOFF
0x0C AIRCR — Application Interrupt and Reset Control Register
  [32:16] VECTKEY, [32:16] VECTKEYSTAT, [16:15] ENDIANESS, [11:8] PRIGROUP, [3:2] SYSRESETREQ, [2:1] VECTCLRACTIVE, [1:0] VECTRESET
0x10 SCR — System Control Register
  [5:4] SEVONPEND, [3:2] SLEEPDEEP, [2:1] SLEEPONEXIT
0x14 CCR — Configuration Control Register
  [10:9] STKALIGN, [9:8] BFHFNMIGN, [5:4] DIV_0_TRP, [4:3] UNALIGN_TRP, [2:1] USERSETMPEND, [1:0] NONBASETHRDENA
{0x18+i} SHP[{i}] (i=0..11) — System Handlers Priority Registers (4-7, 8-11, 12-15)
0x24 SHCSR — System Handler Control and State Register
  [19:18] USGFAULTENA, [18:17] BUSFAULTENA, [17:16] MEMFAULTENA, [16:15] SVCALLPENDED, [15:14] BUSFAULTPENDED, [14:13] MEMFAULTPENDED, [13:12] USGFAULTPENDED, [12:11] SYSTICKACT, [11:10] PENDSVACT, [9:8] MONITORACT, [8:7] SVCALLACT, [4:3] USGFAULTACT, [2:1] BUSFAULTACT, [1:0] MEMFAULTACT
0x28 CFSR — Configurable Fault Status Register
  [32:16] USGFAULTSR — Usage Fault Status Register
  [16:8] BUSFAULTSR — Bus Fault Status Register
  [8:0] MEMFAULTSR — Memory Manage Fault Status Register
0x2C HFSR — HardFault Status Register
  [32:31] DEBUGEVT, [31:30] FORCED, [2:1] VECTTBL
0x30 DFSR — Debug Fault Status Register
  [5:4] EXTERNAL, [4:3] VCATCH, [3:2] DWTTRAP, [2:1] BKPT, [1:0] HALTED
0x34 MMFAR — MemManage Fault Address Register
0x38 BFAR — BusFault Address Register
0x3C AFSR — Auxiliary Fault Status Register
{0x40+4i} PFR[{i}] (i=0..1) ro — Processor Feature Register
0x48 DFR ro — Debug Feature Register
0x4C ADR ro — Auxiliary Feature Register
{0x50+4i} MMFR[{i}] (i=0..3) ro — Memory Model Feature Register
{0x60+4i} ISAR[{i}] (i=0..4) ro — Instruction Set Attributes Register
0x88 CPACR — Coprocessor Access Control Register

## SysTick — System Timer
Base 0xE000E010
0x00 CTRL — SysTick Control and Status Register
  [17:16] COUNTFLAG, [3:2] CLKSOURCE, [2:1] TICKINT, [1:0] ENABLE
0x04 LOAD — SysTick Reload Value Register
  [24:0] RELOAD
0x08 VAL — SysTick Current Value Register
  [24:0] CURRENT
0x0C CALIB ro — SysTick Calibration Register
  [32:31] NOREF, [31:30] SKEW, [24:0] TENMS

## NVIC — Nested Vectored Interrupt Controller
Base 0xE000E100
{0x0+4i} ISER[{i}] (i=0..7) — Interrupt Set Enable Register
{0x80+4i} ICER[{i}] (i=0..7) — Interrupt Clear Enable Register
{0x100+4i} ISPR[{i}] (i=0..7) — Interrupt Set Pending Register
{0x180+4i} ICPR[{i}] (i=0..7) — Interrupt Clear Pending Register
{0x200+4i} IABR[{i}] (i=0..7) — Interrupt Active bit Register
{0x300+i} IP[{i}] (i=0..239) — Interrupt Priority Register (8Bit wide)
0xE00 STIR wo — Software Trigger Interrupt Register
  [9:0] INTID — INTLINESNUM
